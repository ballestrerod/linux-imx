## drivers/pci/switch/Kconfig
```kconfig
menu "PCI switch controller drivers"
	depends on PCI

config PCI_SW_SWITCHTEC
	tristate "MicroSemi Switchtec PCIe Switch Management Driver"
	help
	 Enables support for the management interface for the MicroSemi
	 Switchtec series of PCIe switches. Supports userspace access
	 to submit MRPC commands to the switch via /dev/switchtecX
	 devices. See <file:Documentation/switchtec.txt> for more
	 information.

config PCI_SW_PERICOM
	tristate "Pericom PCIe Switch Driver"
	help
	 Enables support for the management interface for the 
         Pericom PI7C9X2G404EL.

endmenu
```
